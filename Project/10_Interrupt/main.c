#include <reg52.h>
#define uchar unsigned char
#define uint unsigned int

sbit DAT = P3^0;				// 74HC164 数据输入端口
sbit CLK = P3^1;				// 74HC164 时钟输入端口
uint num = 0;					// 显示的数字

// 定义数码管段选(不加小数点0~9)
uchar code table1[]={0x81,0xD7,0xC8,0xC2,0x96,0xA2,0xA0,0xC7,0x80,0x82};

/**********************************************************
*  函数名称：低精度延时函数
*  日期：2019-9-7
*  姓名：ZhangHJ
*  说明：嵌套循环延时
***********************************************************/
void delay(unsigned int mstime)
{
	int i,j;
	for(i=mstime; i>=0; i--)
		for(j=114; j>=0; j--);
}



/**********************************************************
*  函数名称：74HC164发送Byte数据函数
*  日期：2019-9-29
*  姓名：ZhangHJ
*  说明：74HC164移位寄存器输入一字节数据发给寄存器
***********************************************************/
void SendByte_74HC164(uchar byte)
{
	uchar num,c;
	num=table1[byte];
	for(c=0; c<8; c++)
	{
		DAT=num&0x01;		// P3^0 --> 0000 000x
		CLK=0;				// 制造一个上升沿
		CLK=1;
		num>>=1;			// 将数据发送到寄存器
	}
}



/**********************************************************
*  函数名称：配置外部中断0
*  日期：2019-10-22
*  姓名：ZhangHJ
*  说明：1. 选择为下降沿触发方式(为1代表下降沿触发，为0代表低电平触发)
*		 2. 使能外部中断0
* 		 3. 使能总中断
***********************************************************/
void configExtInt0()
{
	IT0 = 1;	//选择为下降沿触发方式(为1代表下降沿触发，为0代表低电平触发)
	EX0 = 1;	//使能外部中断0
	EA = 1;  	//使能总中断
}


/**********************************************************
*  函数名称：外部中断0服务函数
*  日期：2019-10-22
*  姓名：ZhangHJ
*  说明：中断服务函数功能为,使num在0~9之间循环变化
***********************************************************/
void extInt0() interrupt 0
{
	num ++;
	num = num % 10;
}


// 主函数功能：当按下按键KEY时,触发外部中断0,改变数码管显示的数值(0~9)
int main()
{
	configExtInt0();		// 配置外部中断0
	P1 &= 0xf0;				// 位选全部选中
	while(1)
	{
		SendByte_74HC164(num);
		delay(600);
	}
	
}
