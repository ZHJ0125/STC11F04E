#include <reg52.h>

#define uchar unsigned char
#define uint unsigned int
#define FOSC 11059200L							// 晶振频率11.0592MHz(s)
#define CYCLE (12000000.0/FOSC)			// 系统机器周期(us) 
#define SHOWDALAY 6

sbit Trig = P1^4;										// 触发信号
sbit Echo = P1^5;										// 回响信号
sbit DP1 = P3^5;										// 小数点
sbit DAT = P3^0;										// 74HC164 数据输入端口
sbit CLK = P3^1;										// 74HC164 时钟输入端口

//定义数码管段选(不加小数点0~9、'-')
unsigned char code table1[]={0x81,0xD7,0xC8,0xC2,0x96,0xA2,0xA0,0xC7,0x80,0x82,0xfe};


/**********************************************************
*  函数名称：12us高精度延时函数(12.04us)(11.0592MHz)
*  日期：2019-10-4
*  姓名：ZhangHJ
*  说明：嵌套循环延时,延时12.04us已用示波器测量
***********************************************************/
void delay_12us()
{
	int i;
	i++;i++;
}



/**********************************************************
*  函数名称：低精度延时函数
*  日期：2019-9-7
*  姓名：ZhangHJ
*  说明：嵌套循环延时
***********************************************************/
void delay(unsigned int mstime)
{
	int i,j;
	for(i=mstime; i>=0; i--)
		for(j=114; j>=0; j--);
}



/**********************************************************
*  函数名称：74HC164发送Byte函数
*  日期：2019-9-29
*  姓名：ZhangHJ
*  说明：74HC164移位寄存器输入一字节数据发给寄存器
***********************************************************/
void SendByte_74HC164(uchar byte)
{
	uchar num,c;
	num=table1[byte];
	for(c=0; c<8; c++)
	{
		DAT=num&0x01;		// P3^0 --> 0000 000x
		CLK=0;					// 制造一个上升沿
		CLK=1;
		num>>=1;				// 将数据发送到寄存器
	}
}



/**********************************************************
*  函数名称：超声波测距显示函数
*  修改日期：2019-10-9
*  修改人：ZhangHJ
*  说明：1.dist表示需要显示的数值(百/千位数值)
*				 2.A0、A1、A2、A3分别为百位、十位、个位、小数位的数值
***********************************************************/
void display(uint dist)				// 显示程序
{
	uchar A0,A1t,A1,A2t,A2,A3;
	A0 = dist/1000;							// A0 --> 百位
	A1t = dist/100;							// A1t --> 前两位
	A1 = A1t%10;								// A1 --> 十位
	A2t = dist%100;							// A2t --> 后两位
	A2 = A2t/10;								// A2 --> 个位
	A3 = dist%10;								// A3 --> 小数位
	DP1 = 0;										// 小数点
	
	if(A0 >= 10) A0 = 10;
	
	// 控制数码管显示温度数值
	P1 |= 0x0f;
	SendByte_74HC164(A0);
	P1 &= 0xf7;									// 0111
	delay(SHOWDALAY);
	P1 |= 0x0f;

	SendByte_74HC164(A1);
	P1 &= 0xfB;									// 1011
	delay(SHOWDALAY);
	P1 |= 0x0f;
	
	SendByte_74HC164(A2);
	P1 &= 0xfD;									// 1101
	delay(SHOWDALAY);
	P1 |= 0x0f;
	
	SendByte_74HC164(A3);
	P1 &= 0xfE;									// 1110
	delay(SHOWDALAY);
	P1 |= 0x0f;
}




/**********************************************************
*  函数名称：超声波测距函数
*  修改日期：2019-10-9
*  修改人：ZhangHJ
*  说明：1. 采用IO口TRIG触发测距，给至少10us的高电平信号
*				 2. 模块自动发送8个40khz的方波，自动检测是否有信号返回
*				 3. 若有信号返回，通过IO口ECHO输出一个高电平，高电平持续的时间就是超声波从发射到返回的时间
*				 4. 测试距离 = (高电平时间*声速(340M/S))/2
***********************************************************/
float GetDistance()
{
	float dist = 0.0f;
	uint count = 0;
	
	TMOD = 0x01;											// 计时器0方式1	(16位计数器,TL0、TH0全用)
	TH0 = TL0 = 0;										// 装入初值
	Trig = 1;													// 打开触发
	delay_12us();											// 延时一会儿,保证延时10us时间
	Trig = 0;													// 关闭触发
	while(!Echo);											// 测距过程中
	TR0 = 1;													// 打开中断
	while(Echo);											// 等待输出电平结束
	TR0 = 0;													// 关闭中断
	count = (TH0 << 8) | TL0;					// 读取16位计时器里的数字
	dist = CYCLE * count * 0.017 * 2;			// 0.017cm/us
	return dist;											// 返回值是一个浮点型数据
}



// 主函数功能: 循环测距，在数码管上显示距离
void main()
{
	uint dis;
	uint i;
	Trig = 0;
	Echo = 1;
	delay(200);												// 初始化等待
	
	while(1)
	{
		dis = (int)(GetDistance()*10);	// 开始测距
		for(i=200; i>0; i--)
		{
			display(dis);									// 循环显示
		}
	}
}


