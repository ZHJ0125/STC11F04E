#include <reg52.h>

#define uchar unsigned char
#define uint unsigned int
#define FOSC 11059200L							// 晶振频率11.0592MHz(s)
#define CYCLE (12000000.0/FOSC)			// 系统机器周期(us) 
#define SHOWDALAY 6

sbit DAT = P3^0;										// 74HC164 数据输入端口
sbit CLK = P3^1;										// 74HC164 时钟输入端口

//定义数码管段选(不加小数点0~9、'-')
unsigned char code table1[]={0x81,0xD7,0xC8,0xC2,0x96,0xA2,0xA0,0xC7,0x80,0x82,0xfe};


/**********************************************************
*  函数名称：12us高精度延时函数(12.04us)(11.0592MHz)
*  日期：2019-10-4
*  姓名：ZhangHJ
*  说明：嵌套循环延时,延时12.04us已用示波器测量
***********************************************************/
void delay_12us()
{
	int i;
	i++;i++;
}



/**********************************************************
*  函数名称：低精度延时函数
*  日期：2019-9-7
*  姓名：ZhangHJ
*  说明：嵌套循环延时
***********************************************************/
void delay(unsigned int mstime)
{
	int i,j;
	for(i=mstime; i>=0; i--)
		for(j=114; j>=0; j--);
}



/**********************************************************
*  函数名称：74HC164发送Byte函数
*  日期：2019-9-29
*  姓名：ZhangHJ
*  说明：74HC164移位寄存器输入一字节数据发给寄存器
***********************************************************/
void SendByte_74HC164(uchar byte)
{
	uchar num,c;
	num=table1[byte];
	for(c=0; c<8; c++)
	{
		DAT=num&0x01;		// P3^0 --> 0000 000x
		CLK=0;					// 制造一个上升沿
		CLK=1;
		num>>=1;				// 将数据发送到寄存器
	}
}



/**********************************************************
*  函数名称：超声波测距显示函数
*  修改日期：2019-10-9
*  修改人：ZhangHJ
*  说明：1.dist表示需要显示的数值(百/千位数值)
*				 2.A0、A1、A2、A3分别为百位、十位、个位、小数位的数值
***********************************************************/
void display(uint dist)				// 显示程序
{
	uchar A0,A1t,A1,A2t,A2,A3;
	A0 = dist/1000;							// A0 --> 千位
	A1t = dist/100;							// A1t --> 前两位
	A1 = A1t%10;								// A1 --> 百位
	A2t = dist%100;							// A2t --> 后两位
	A2 = A2t/10;								// A2 --> 十位
	A3 = dist%10;								// A3 --> 个位
	
	// 控制数码管显示温度数值
	P1 |= 0x0f;
	SendByte_74HC164(A0);
	P1 &= 0xf7;									// 0111
	delay(SHOWDALAY);
	P1 |= 0x0f;

	SendByte_74HC164(A1);
	P1 &= 0xfB;									// 1011
	delay(SHOWDALAY);
	P1 |= 0x0f;
	
	SendByte_74HC164(A2);
	P1 &= 0xfD;									// 1101
	delay(SHOWDALAY);
	P1 |= 0x0f;
	
	SendByte_74HC164(A3);
	P1 &= 0xfE;									// 1110
	delay(SHOWDALAY);
	P1 |= 0x0f;
}




/**********************************************************
*  函数名称：定时器机器周期测试函数
*  修改日期：2019-10-11
*  修改人：ZhangHJ
*  说明：1. 初始化计时模式,打开中断计时
*				 2. 延时12us,关闭计时
*				 3. 正确的话计数值应该是 11
***********************************************************/
uint GetCount()
{
	uint count = 0;
	
	TMOD = 0x01;											// 计时器0方式1	(16位计数器,TL0、TH0全用)
	TH0 = TL0 = 0;										// 装入初值

	TR0 = 1;													// 打开中断,开始计时测试
	delay_12us();											// 延时12us
	TR0 = 0;													// 关闭中断
	count = (TH0 << 8) | TL0;					// 读取16位计时器里的数字
	return count;											// 返回计数个数
}



// 主函数功能: 测试一次计时器机器周期
void main()
{
	uint dis;
	uint i;
	delay(200);												// 初始化等待
	
	while(1)
	{
		dis = GetCount();								// 开始测试时间
		for(i=200; i>0; i--)
		{
			display(dis);									// 循环显示计数值
		}
	}
}


